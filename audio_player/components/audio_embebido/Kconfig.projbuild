## audio_player/components/audio_embebido/Kconfig.projbuild
```kconfig
menu "Audio Embebido Config"
    config AUDIO_EMBEBIDO_PA_CTRL_IO
        int "GPIO de control del amplificador (PA)"
        default 10
endmenu
```
